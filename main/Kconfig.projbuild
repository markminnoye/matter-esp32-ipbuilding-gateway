## main/Kconfig.projbuild
```kconfig
menu "IPBuilding Gateway"

    config WIFI_SSID
        string "WiFi SSID (home LAN, Matter commissioning)"
        default "YOUR_SSID"
        help
            Home LAN WiFi network used for Matter over WiFi.

    config WIFI_PASSWORD
        string "WiFi password"
        default "YOUR_PASSWORD"
        help
            WiFi password. Set via menuconfig — never commit sdkconfig with real credentials.

    config ETH_STATIC_IP
        string "Field-bus Ethernet IP"
        default "10.10.1.1"
        help
            Static IP on the IPBuilding VLAN (W5500 interface).

    config ETH_STATIC_GW
        string "Field-bus Ethernet gateway"
        default "10.10.1.1"

    config ETH_STATIC_NETMASK
        string "Field-bus Ethernet netmask"
        default "255.255.255.0"

    config MATTER_BRIDGE_NODE_LABEL
        string "Matter bridge name (NodeLabel)"
        default "IPBuilding Gateway"
        help
            User-visible name for the root Matter node in Apple Home / HA (Basic
            Information NodeLabel, max 32 characters). Change via menuconfig;
            already-commissioned fabrics may keep the old name until re-added.

    config VELDBUS_POLL_INTERVAL_MS
        int "Veldbus input poll interval (ms)"
        default 2000
        range 500 10000
        help
            Time between IP1100 input polls (I0000). IPBox steady-state ~2 s.
            Relay channel status is NOT polled here — boot sweep seeds initial
            state; runtime updates are unsolicited status lines on the rx task.

    config VELDBUS_ACTUATOR_POLL_INTERVAL_MS
        int "Veldbus actuator poll interval (ms)"
        default 20000
        range 500 60000
        help
            Time between relay/dimmer keep-alive polls (P0000 / I9900).
            IPBox steady-state ~20 s. Input uses VELDBUS_POLL_INTERVAL_MS.

endmenu
```
